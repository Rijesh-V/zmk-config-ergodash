## config/west.yml
```yaml
manifest:
  remotes:
    - name: zmkfirmware
      url-base: https://github.com/zmkfirmware

  projects:
    - name: zmk
      remote: zmkfirmware
      revision: main
      path: zmk
      west-commands: scripts/west_commands.yml

    - name: ergodash_left
      path: boards/shields/ergodash_left
      revision: main
      description: Custom shield for ErgoDash left half

    - name: ergodash_right
      path: boards/shields/ergodash_right
      revision: main
      description: Custom shield for ErgoDash right half
```

## shields/ergodash_left/kconfig
```kconfig
# shields/ergodash_left/Kconfig

config KEYBOARD_LEFT
    bool "Left half of ErgoDash (Primary)"
    default y
    help
      Select this option to configure the left half as the primary controller of the ErgoDash keyboard.

# Enable I2C communication (left side communicates with the right side)
config I2C
    bool "Enable I2C communication"
    default y
    help
      Enable I2C communication for the split keyboard. The left half controls the I2C communication to the right half.

# Define the I2C pins for left half
config I2C_SDA_PIN
    int "I2C SDA Pin"
    default 3   # GPIO pin for SDA on the left half
    help
      Set the GPIO pin for I2C SDA on the left half of the keyboard.

config I2C_SCL_PIN
    int "I2C SCL Pin"
    default 4   # GPIO pin for SCL on the left half
    help
      Set the GPIO pin for I2C SCL on the left half of the keyboard.

# Define the matrix row and column pins for the left half
config MATRIX_LEFT_ROWS
    int "Matrix Rows for Left Half"
    default 0   # Pin number for row 0
    help
      Set the GPIO pin for the row 0 on the left half of the matrix.

config MATRIX_LEFT_COLS
    int "Matrix Columns for Left Half"
    default 1   # Pin number for column 0
    help
      Set the GPIO pin for the column 0 on the left half of the matrix.

# Enable Bluetooth communication if the left half has Bluetooth enabled
config BT_NRF52
    bool "Enable Bluetooth on Left Half"
    default y
    help
      Enable Bluetooth on the left half of the keyboard (Primary). This board will handle Bluetooth communication.
```

## shields/ergodash_right/kconfig
```kconfig
# shields/ergodash_right/Kconfig

config KEYBOARD_RIGHT
    bool "Right half of ErgoDash (Slave)"
    default y
    help
      Select this option to configure the right half as the slave board of the ErgoDash keyboard.

# Enable I2C communication (right half receives from the left half)
config I2C
    bool "Enable I2C communication"
    default y
    help
      Enable I2C communication for the split keyboard. The right half receives data from the left half.

# Define the I2C pins for right half
config I2C_SDA_PIN
    int "I2C SDA Pin"
    default 5   # GPIO pin for SDA on the right half
    help
      Set the GPIO pin for I2C SDA on the right half of the keyboard.

config I2C_SCL_PIN
    int "I2C SCL Pin"
    default 6   # GPIO pin for SCL on the right half
    help
      Set the GPIO pin for I2C SCL on the right half of the keyboard.

# Define the matrix row and column pins for the right half
config MATRIX_RIGHT_ROWS
    int "Matrix Rows for Right Half"
    default 2   # Pin number for row 0
    help
      Set the GPIO pin for the row 0 on the right half of the matrix.

config MATRIX_RIGHT_COLS
    int "Matrix Columns for Right Half"
    default 3   # Pin number for column 0
    help
      Set the GPIO pin for the column 0 on the right half of the matrix.

# Disable Bluetooth on the right half since it's managed by the left half
config BT_NRF52
    bool "Disable Bluetooth on Right Half"
    default n
    help
      Disable Bluetooth on the right half. The left half will handle Bluetooth communication.
```
